## src/mainboard/supermicro/x11-lga1151v2-series/Kconfig
```kconfig
config BOARD_SUPERMICRO_BASEBOARD_X11_LGA1151V2_SERIES
	def_bool n
	select BOARD_ROMSIZE_KB_32768
	select DRIVERS_ASPEED_AST2050
	select DRIVERS_UART_8250IO
	select HAVE_ACPI_RESUME
	select HAVE_ACPI_TABLES
	select IPMI_KCS
	select SOC_INTEL_CANNONLAKE_PCH_H
	select SOC_INTEL_COFFEELAKE
	select SOC_INTEL_COMMON_BLOCK_LPC_COMB_ENABLE
	select SUPERIO_ASPEED_AST2400
	select SUPERIO_ASPEED_COMMON_PRE_RAM
	select SUPERIO_ASPEED_HAS_UART_DELAY_WORKAROUND

if BOARD_SUPERMICRO_BASEBOARD_X11_LGA1151V2_SERIES

config MAINBOARD_DIR
	default "supermicro/x11-lga1151v2-series"

config MAINBOARD_FAMILY
	string
	default "Supermicro X11 LGA1151v2 Series"

config MAINBOARD_PART_NUMBER
	default "X11SCH-F"	if BOARD_SUPERMICRO_X11SCH_F

config MAX_CPUS
	default 16

config VARIANT_DIR
	default "x11sch-f"	if BOARD_SUPERMICRO_X11SCH_F

config OVERRIDE_DEVICETREE
	default "variants/\$(CONFIG_VARIANT_DIR)/overridetree.cb"

config DIMM_SPD_SIZE
	default 512

config POST_DEVICE
	default n

config POST_IO
	default n

config CBFS_SIZE
	default 0xa00000

endif # BOARD_SUPERMICRO_BASEBOARD_X11_LGA1151V2_SERIES
```

## src/mainboard/supermicro/x11-lga1151v2-series/Kconfig.name
```kconfig
config BOARD_SUPERMICRO_X11SCH_F
	bool "X11SCH-F"
	select BOARD_SUPERMICRO_BASEBOARD_X11_LGA1151V2_SERIES

config BOARD_SUPERMICRO_X11SCL_IF
	bool "X11SCL-IF"
	select BOARD_SUPERMICRO_BASEBOARD_X11_LGA1151V2_SERIES
```
